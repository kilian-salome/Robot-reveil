 #include <config.h>
#include <ds3231.h>
#include <Wire.h>

#include <NewPing.h>
#include<SoftwareSerial.h>

#include <NewTone.h>
#define TONE_PIN 26

#define RX 12
#define TX 13
SoftwareSerial BlueT(RX, TX);


#include <SPI.h>
#include <Wire.h>
#include <Adafruit_GFX.h>
#include <Adafruit_SSD1351.h>

#define OLED_DC    9
#define OLED_CS1  10
#define OLED_CS2  11
#define OLED_RESET1 8
#define OLED_RESET2 7

Adafruit_SSD1351 display1 = Adafruit_SSD1351(OLED_CS1, OLED_DC, OLED_RESET1);
Adafruit_SSD1351 display2 = Adafruit_SSD1351(OLED_CS2, OLED_DC, OLED_RESET2);

// Color definitions
#define  BLACK           0x0000
#define BLUE            0x001F
#define RED             0xF800
#define GREEN           0x07E0
#define CYAN            0x07FF
#define MAGENTA         0xF81F
#define YELLOW          0xFFE0
#define WHITE           0xFFFF

int ENA = 2;
int IN1 = 30;
int IN2 = 31;
int IN3 = 32;
int IN4 = 33;
int ENB = 3;



int cm;
NewPing sonar(22, 23, 50);

const int button =39;
int val;
int cond;



struct ts t;
struct ts a;

int alarmMinutes = 0;
int alarmHeures = 0;





const unsigned char OEIL1 [] PROGMEM = {
 0x00, 0x00, 0x00, 0x00, 0x00, 0x00, 0x00, 0x00, 0x00, 0x00, 0x00, 0x00, 0x00, 0x00, 0x00, 0x00, 
  0x00, 0x00, 0x00, 0x00, 0x00, 0x00, 0x00, 0x00, 0x00, 0x00, 0x00, 0x00, 0x00, 0x00, 0x00, 0x00, 
  0x00, 0x00, 0x00, 0x00, 0x00, 0x00, 0x00, 0x00, 0x00, 0x00, 0x00, 0x00, 0x00, 0x00, 0x00, 0x00, 
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  0x00, 0x00, 0x00, 0x00, 0x00, 0x00, 0x00, 0x00, 0x00, 0x00, 0x00, 0x00, 0x00, 0x00, 0x00, 0x00
};

// 'ECRAN3', 128x128px
const unsigned char OEIL2 [] PROGMEM = {
  0x00, 0x00, 0x00, 0x00, 0x00, 0x00, 0x00, 0x00, 0x00, 0x00, 0x00, 0x00, 0x00, 0x00, 0x00, 0x00, 
  0x00, 0x00, 0x00, 0x00, 0x00, 0x00, 0x00, 0x00, 0x00, 0x00, 0x00, 0x00, 0x00, 0x00, 0x00, 0x00, 
  0x00, 0x00, 0x00, 0x00, 0x00, 0x00, 0x00, 0x00, 0x00, 0x00, 0x00, 0x00, 0x00, 0x00, 0x00, 0x00, 
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  0x00, 0x00, 0x00, 0x00, 0x00, 0x00, 0x00, 0x00, 0x00, 0x00, 0x00, 0x00, 0x00, 0x00, 0x00, 0x00
};



void setup() {
  Serial.begin(9600);
  BlueT.begin(9600);
  Wire.begin();  
  display1.begin();
  display2.begin();


  pinMode(button, INPUT);
  pinMode(ENA, OUTPUT);
  pinMode(ENB, OUTPUT);
  pinMode(IN1, OUTPUT);
  pinMode(IN2, OUTPUT);
  pinMode(IN3, OUTPUT);
  pinMode(IN4, OUTPUT);
  
  display1.fillScreen(BLACK);
  display2.fillScreen(BLACK);
  dessinerOeil();
  

  digitalWrite(ENA,0);
  digitalWrite(ENB,0);
  cond=1;

  
//  DS3231_init(DS3231_INTCN);
//remettreHeure(t,14,57,0,10,3,2019);
}

void loop() {

  DS3231_get(&t);
  val = digitalRead(button);
  cm = sonar.ping_cm();
  Serial.print("cm");
  Serial.println(cm);


  //Serial.println(alarmMinutes);
  //Serial.print("min");
  //Serial.println(t.min);
  //Serial.println(alarmHeures);
  //Serial.print("hour");
  //Serial.println(t.hour);

  //Serial.print("cond=");
  //Serial.println(cond);
  //Serial.print("val=");
  //Serial.println(val);

 if (cond==1){
  Serial.println("1");
  if (BlueT.available()) {
    Serial.println("rentrer boucle 0");
    alarmMinutes = recupererAlarm(a).min;
    alarmHeures = recupererAlarm(a).hour;
    cond = 0;
  }
  if (cm > 0 && cm < 25) {
    
    Serial.println("rentrer boucle 3");
    afficherDateMONI(t);
    display1.fillScreen(BLACK);
    display2.fillScreen(BLACK);
    afficherHeure();

    display1.fillScreen(BLACK);
    display2.fillScreen(BLACK);
      dessinerOeil();
    cm = 0;
  }
  
  }
else{
  if (alarmMinutes == t.min && alarmHeures == t.hour && cond == 0) {
    cond = 2;
  }



  if (cond == 2) {
    Serial.println("rentrer boucle 1");
    afficherStop();
    // faireSonnerReveil();
    faireRoulerrobot();

    if (val == LOW) {
      analogWrite(ENA, 0);
      analogWrite(ENB, 0);
      Serial.println("rentrer boucle 2");
      cond = 1; 
  display1.fillScreen(BLACK);
  display2.fillScreen(BLACK);
   dessinerOeil();
    }
  }}

  
}


















void remettreHeure(struct ts t, int heure, int minu, int sec, int mday, int mon, int year) {
  t.hour = heure;
  t.min = minu;
  t.sec = sec;
  t.mday = mday;
  t.mon = mon;
  t.year = year;

  DS3231_set(t);
}

void afficherDateMONI(struct ts t) {
  Serial.print("date : ");
  Serial.print(t.mday);
  Serial.print("/");
  Serial.print(t.mon);
  Serial.print("/");
  Serial.print(t.year);
  Serial.print("\t Heure : ");
  Serial.print(t.hour);
  Serial.print(":");
  Serial.print(t.min);
  Serial.print(".");
  Serial.println(t.sec);
}

/*void afficherDateLCD(struct ts t){
  lcd.clear();
  lcd.setCursor(0, 0);
  lcd.print(t.mday);
  lcd.print("/");
  lcd.print(t.mon);
  lcd.print("/");
  lcd.print(t.year);
  lcd.setCursor(0,1);
  lcd.print(t.hour);
  lcd.print(":");
  lcd.print(t.min);
  lcd.print(".");
  lcd.print(t.sec);}
*/
struct ts recupererAlarm(struct ts a) {
  if (BlueT.available()) {
    //Serial.print(int(BlueT.read()));
    //Serial.println("");
    a.hour = int(BlueT.read());
    delay(1000);
    a.min = int(BlueT.read());
    Serial.print("Alarme:");
    Serial.print(a.hour);
    Serial.print(" h ");
    Serial.println(a.min);
    return a;
  }
}

void faireSonnerReveil() {
  Serial.println("STOP");

  for (unsigned long freq = 500 ; freq < 1000; freq++) {
    NewTone(TONE_PIN, freq); // Play the frequency (125 Hz to 15 kHz sweep in 10 Hz steps).
    delay(1);
  }
  for (unsigned long freq = 1000 ; freq > 500; freq--) {
    NewTone(TONE_PIN, freq); // Play the frequency (125 Hz to 15 kHz sweep in 10 Hz steps).
    delay(1);
  }

  noNewTone(TONE_PIN);
}


void faireRoulerrobot() {
faireSonnerReveil();
  cm = sonar.ping_cm();
  int vitesse=255;


  if (cm > 10 || cm == 0) {
    digitalWrite(IN1, LOW);
    digitalWrite(IN2, HIGH);
    digitalWrite(IN3, LOW);
    digitalWrite(IN4, HIGH);


    analogWrite(ENA, vitesse);
    analogWrite(ENB, vitesse);
  }

   else {
    int i = vitesse;
    while (i > 0) {
      analogWrite(ENA, i);
      analogWrite(ENB, i);
      i -= 15;
      
    Serial.println("decceler");
      delay(20);
    }


  
    digitalWrite(IN1, HIGH);
    digitalWrite(IN2, LOW);
    digitalWrite(IN3, HIGH);
    digitalWrite(IN4, LOW);
    
     i = 0;


     
    while (i < vitesse) {
      analogWrite(ENA, i);
      analogWrite(ENB, i);
      
    Serial.println("acceler");
      i += 15;
      delay(20);
    }
    
digitalWrite(IN1, HIGH);
    digitalWrite(IN2, LOW);
    digitalWrite(IN3, HIGH);
    digitalWrite(IN4, LOW);

      analogWrite(ENA, vitesse);
      analogWrite(ENB, vitesse);
faireSonnerReveil();
    Serial.println("boucle reculer");


while (i > 0) {
      analogWrite(ENA, i);
      analogWrite(ENB, i);
      i -= 15;
      
    Serial.println("decceler");
      delay(20);
    }


  
digitalWrite(IN1, HIGH);
    digitalWrite(IN2, LOW);
    // Direction du Moteur B
    // NB: en sens inverse du moteur

    digitalWrite(IN3, LOW);
    digitalWrite(IN4, HIGH);
    
     i = 0;
    while (i < vitesse) {
      analogWrite(ENA, i);
      analogWrite(ENB, i);
      
    Serial.println("acceler");
      i += 15;
      delay(20);
    }
    Serial.println("boucle tourner");

    
while (i > 0) {
      analogWrite(ENA, i);
      analogWrite(ENB, i);
      i -= 15;
      
    Serial.println("decceler");
      delay(20);
    }

    
    digitalWrite(IN1, LOW);
    digitalWrite(IN2, HIGH);
    digitalWrite(IN3, LOW);
    digitalWrite(IN4, HIGH);

  }
  

}
void afficherStop(){

  
display1.fillScreen(BLACK);
display2.fillScreen(BLACK);
  
  display1.setTextSize(3);
  display1.setTextColor(RED);
  display1.setCursor(0, 35);
  display1.print("reveille");



  display2.setTextSize(3);
  display2.setTextColor(RED);
  display2.setCursor(20, 35);
 
  display2.print("toi!!");


  
}

void afficherHeure() {
  int i=0;
  while (i<1300){
     DS3231_get(&t);
  display1.setTextSize(6);
  display1.setTextColor(RED);
  display1.setCursor(20, 35);
  display1.print(t.hour);
  display1.print("h");



  display2.setTextSize(6);
  display2.setTextColor(RED);
  display2.setCursor(20, 35);
 
  display2.print(t.min);
  display2.setCursor(80, 80);
 
  display2.setTextSize(3);
display2.print(t.sec);
i=i+1000;
delay(1000);

display2.fillScreen(BLACK);
}}



void dessinerOeil() {

  display1.drawBitmap(0, 0, OEIL2, 128, 128, YELLOW);

  display2.drawBitmap(0, 0, OEIL1, 128, 128, YELLOW);
  
}
